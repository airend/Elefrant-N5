/* Copyright (c) 2014, The Linux Foundation. All rights reserved.
 *
 * This program is free software; you can redistribute it and/or modify
 * it under the terms of the GNU General Public License version 2 and
 * only version 2 as published by the Free Software Foundation.
 *
 * This program is distributed in the hope that it will be useful,
 * but WITHOUT ANY WARRANTY; without even the implied warranty of
 * MERCHANTABILITY or FITNESS FOR A PARTICULAR PURPOSE.  See the
 * GNU General Public License for more details.
 */

&mdss_mdp {
	dsi_jdi_command_ors: qcom,mdss_dsi_jdi_command_ors {
		qcom,mdss-dsi-panel-name = "JDI 1080p command mode dsi panel";
		qcom,mdss-dsi-panel-controller = <&mdss_dsi0>;
		qcom,mdss-dsi-panel-type = "dsi_cmd_mode";
		qcom,mdss-dsi-panel-height = <1920>;
		qcom,mdss-dsi-panel-width = <1080>;
		qcom,mdss-dsi-bpp = <24>;
		qcom,mdss-pan-physical-width-dimension = <62>;
		qcom,mdss-pan-physical-height-dimension = <110>;
		qcom,mdss-dsi-panel-destination = "display_1";
		qcom,mdss-dsi-h-sync-skew = <0>;
		qcom,mdss-dsi-h-front-porch = <4>;
		qcom,mdss-dsi-h-pulse-width = <2>;
		qcom,mdss-dsi-h-back-porch = <2>;
		qcom,mdss-dsi-v-back-porch = <2>;
		qcom,mdss-dsi-v-pulse-width = <2>;
		qcom,mdss-dsi-v-front-porch = <2>;
		qcom,mdss-dsi-h-left-border = <0>;
		qcom,mdss-dsi-h-right-border = <0>;
		qcom,mdss-dsi-v-top-border = <0>;
		qcom,mdss-dsi-v-bottom-border = <0>;
		qcom,mdss-dsi-underflow-color = <0xff>;
		qcom,mdss-dsi-bl-min-level = <1>;
		qcom,mdss-dsi-bl-max-level = <255>;
		qcom,mdss-dsi-te-check-enable;
		qcom,mdss-dsi-te-using-te-pin;
		qcom,mdss-dsi-te-pin-select = <1>;
		qcom,mdss-dsi-h-sync-pulse = <0>;
		qcom,mdss-dsi-hfp-power-mode;
		qcom,mdss-dsi-hsa-power-mode;
		qcom,mdss-dsi-hbp-power-mode;
		qcom,mdss-dsi-bllp-power-mode;
		qcom,mdss-dsi-bllp-eof-power-mode;
		qcom,mdss-dsi-virtual-channel-id = <0>;
		qcom,mdss-dsi-color-order = <0>;
		qcom,mdss-dsi-lane-0-state;
		qcom,mdss-dsi-lane-1-state;
		qcom,mdss-dsi-lane-2-state;
		qcom,mdss-dsi-lane-3-state;
		qcom,mdss-dsi-t-clk-pre = <0x35>;
		qcom,mdss-dsi-t-clk-post = <0x1E>;
		qcom,mdss-dsi-stream = <0>;
		qcom,mdss-dsi-mdp-trigger = "none";
		qcom,mdss-dsi-dma-trigger = "trigger_sw";
		qcom,mdss-dsi-panel-framerate = <60>;
		qcom,mdss-dsi-panel-clockrate = <804667392>;
		qcom,mdss-dsi-te-dcs-command = <1>;
		qcom,mdss-dsi-reset-sequence = <1 15>, <0 20>, <1 15>;
		qcom,mdss-dsi-on-pre-reset-delay = <20>;
		qcom,mdss-dsi-off-pre-reset-delay = <20>;
		qcom,mdss-dsi-off-post-reset-delay = <20>;
		qcom,mdss-dsi-panel-timings = [
			c1 3d 34 00 58 4d
			36 3f 53 03 04 00];
		qcom,mdss-dsi-regulator-settings = [
			03 01 01 00 20 00 01];
		qcom,mdss-dsi-strength-ctrl = [
			bb 06];
		qcom,mdss-dsi-lane-config = [
			00 c2 45 00 00 00 00 01 75
			00 c2 45 00 00 00 00 01 75
			00 c2 45 00 00 00 00 01 75
			00 c2 45 00 00 00 00 01 75
			00 02 45 00 00 00 00 01 97];
		qcom,mdss-dsi-on-command = [
			15 01 00 00 00 00 02 00 00
			39 01 00 00 00 00 05
			FF 19 02 01 00
			15 01 00 00 00 00 02 00 80
			39 01 00 00 00 00 03
			FF 19 02
			15 01 00 00 00 00 02 00 00
			39 01 00 00 00 00 03
			D8 20 20
			15 01 00 00 00 00 02 00 00
			39 01 00 00 00 00 19
			E1 00 0A 11 1B 25
			2D 38 48 53 65 70
			79 80 7B 75 6A 5B
			4E 44 3E 35 26 16
			00
			15 01 00 00 00 00 02 00 00
			39 01 00 00 00 00 19
			E2 00 0A 11 1B 25
			2D 38 48 53 65 70
			79 80 7B 75 6A 5B
			4E 44 3E 35 26 16
			00
			15 01 00 00 00 00 02 00 00
			39 01 00 00 00 00 19
			E3 47 49 4B 4E 51
			54 5A 64 69 75 7C
			82 79 75 6F 64 55
			49 40 3A 32 25 15
			00
			15 01 00 00 00 00 02 00 00
			39 01 00 00 00 00 19
			E4 47 49 4B 4E 51
			54 5A 64 69 75 7C
			82 79 75 6F 64 55
			49 40 3A 32 25 15
			00
			15 01 00 00 00 00 02 00 00
			39 01 00 00 00 00 19
			E5 56 57 59 5B 5E
			60 65 6D 6F 79 7E
			83 78 74 6E 63 54
			47 3D 34 28 21 14
			00
			15 01 00 00 00 00 02 00 00
			39 01 00 00 00 00 19
			E6 56 57 59 5B 5E
			60 65 6D 6F 79 7E
			83 78 74 6E 63 54
			47 3D 34 28 21 14
			00
			15 01 00 00 00 00 02 00 00
			15 01 00 00 00 00 02 00 00
			39 01 00 00 00 00 05
			FF 19 02 01 00
			15 01 00 00 00 00 02 00 80
			39 01 00 00 00 00 03
			FF 19 02
			15 01 00 00 00 00 02 00 83
			15 01 00 00 00 00 02 F3 CA
			15 01 00 00 00 00 02 00 90
			15 01 00 00 00 00 02 C4 00
			15 01 00 00 00 00 02 00 B0
			39 01 00 00 00 00 0F
			C5 92 D6 A0 15 A0 1E A0 06
			A0 0C 44 33 30 88
			15 01 00 00 00 00 02 00 00
			15 01 00 00 00 00 02 35 00
			39 01 00 00 00 00 05
			2A 00 00 04 37
			39 01 00 00 00 00 05
			2B 00 00 07 7F
			05 01 00 00 78 00 01 11
			05 01 00 00 00 00 01 29];
		qcom,mdss-dsi-on-command-state = "dsi_lp_mode";
		qcom,mdss-dsi-off-command = [
			05 01 00 00 32 00 01 28
			05 01 00 00 64 00 01 10];
		qcom,mdss-dsi-off-command-state = "dsi_hs_mode";
		qcom,mdss-dsi-bl-pmic-control-type = "bl_ctrl_wled";
		qcom,cont-splash-enabled;
		qcom,ulps-enabled;
		qcom,partial-update-enabled;
		qcom,panel-roi-alignment = <2 2 2 2 8 8>;
	};

	qcom,mdss_dsi_jdi_command_ors_j1 {
		compatible = "qcom,mdss-dsi-panel";
		label = "JDI(J1) 1080p command mode dsi panel";
		status = "disable";
		qcom,dsi-ctrl-phandle = <&mdss_dsi0>;
		qcom,enable-gpio = <&msmgpio 58 0>;
		qcom,rst-gpio = <&pm8941_gpios 19 0>;
		qcom,te-gpio = <&msmgpio 12 0>;
		qcom,mdss-pan-id = <5>;
		qcom,mdss-pan-res = <1080 1920>;
		qcom,mdss-pan-bpp = <24>;
		qcom,mdss-pan-width = <62>;
		qcom,mdss-pan-height = <110>;
		qcom,mdss-pan-dest = "display_1";
		qcom,mdss-pan-porch-values = <2 2 4 2 2 2>;
		qcom,mdss-pan-underflow-clr = <0xff>;
		qcom,mdss-pan-bl-ctrl = "bl_ctrl_wled";
		qcom,mdss-pan-bl-levels = <1 255>;
		qcom,mdss-pan-dsi-mode = <1>;
		qcom,mdss-vsync-enable = <1>;
		qcom,mdss-hw-vsync-mode = <1>;
		qcom,mdss-pan-dsi-h-pulse-mode = <0>;
		qcom,mdss-pan-dsi-h-power-stop = <0 0 0>;
		qcom,mdss-pan-dsi-bllp-power-stop = <1 1>;
		qcom,mdss-pan-dsi-traffic-mode = <1>;
		qcom,mdss-pan-dsi-dst-format = <8>;
		qcom,mdss-pan-dsi-vc = <0>;
		qcom,mdss-pan-dsi-rgb-swap = <0>;
		qcom,mdss-pan-dsi-data-lanes = <1 1 1 1>;
		qcom,mdss-pan-dsi-dlane-swap = <0>;
		qcom,mdss-pan-dsi-t-clk = <0x35 0x1E>;
		qcom,mdss-pan-dsi-stream = <0>;
		qcom,mdss-pan-dsi-mdp-tr = <0x0>;
		qcom,mdss-pan-dsi-dma-tr = <0x04>;
		qcom,mdss-pan-dsi-frame-rate = <60>;
		qcom,mdss-pan-clk-rate = <804667392>;
		qcom,mdss-pan-te-sel = <1>;
		qcom,mdss-pan-wr-mem-continue = <0x3c>;
		qcom,mdss-pan-wr-mem-start = <0x2c>;
		qcom,mdss-pan-insert-dcs-cmd = <1>;
		qcom,panel-phy-regulatorSettings = [
			03 01 01 00  /* Regualotor settings */
			20 00 01];
		qcom,panel-phy-timingSettings = [
			c1 3d 34 00 58 4d
			36 3f 53 03 04 00];
		qcom,panel-phy-strengthCtrl = [
			bb 06];
		qcom,panel-phy-bistCtrl = [
			00 00 b1 ff           /* BIST Ctrl settings */
			00 00];
		qcom,panel-phy-laneConfig = [
			00 c2 45 00 00 00 00 01 75 /* lane0 config */
			00 c2 45 00 00 00 00 01 75 /* lane1 config */
			00 c2 45 00 00 00 00 01 75 /* lane2 config */
			00 c2 45 00 00 00 00 01 75 /* lane3 config */
			00 02 45 00 00 00 00 01 97]; /* Clk ln config */
		qcom,panel-on-cmds = [
			15 01 00 00 00 00 02 00 00
			39 01 00 00 00 00 05
			FF 19 02 01 00
			15 01 00 00 00 00 02 00 80
			39 01 00 00 00 00 03
			FF 19 02
			15 01 00 00 00 00 02 00 00
			39 01 00 00 00 00 03
			D8 1C 1C
			15 01 00 00 00 00 02 00 00
			39 01 00 00 00 00 19
			E1 00 06 0D 12 19
			1F 29 39 46 56 63
			6D 8B 85 7D 6F 60
			4D 44 3F 38 27 18
			00
			15 01 00 00 00 00 02 00 00
			39 01 00 00 00 00 19
			E2 00 06 0D 12 19
			1F 29 39 46 56 63
			6D 8B 85 7D 6F 60
			4D 44 3F 38 27 18
			00
			15 01 00 00 00 00 02 00 00
			39 01 00 00 00 00 19
			E3 37 39 3C 3E 40
			45 49 53 5A 65 6E
			75 85 80 79 6C 5A
			49 40 3D 36 26 17
			00
			15 01 00 00 00 00 02 00 00
			39 01 00 00 00 00 19
			E4 37 39 3C 3E 40
			45 49 53 5A 65 6E
			75 85 80 79 6C 5A
			49 40 3D 36 26 17
			00
			15 01 00 00 00 00 02 00 00
			39 01 00 00 00 00 19
			E5 37 39 3B 3E 40
			43 48 51 58 63 6C
			73 86 81 79 6B 5D
			4A 40 3C 36 28 1A
			00
			15 01 00 00 00 00 02 00 00
			39 01 00 00 00 00 19
			E6 37 39 3B 3E 40
			43 48 51 58 63 6C
			73 86 81 79 6B 5D
			4A 40 3C 36 28 1A
			00
			15 01 00 00 00 00 02 00 00
			15 01 00 00 00 00 02 00 00
			39 01 00 00 00 00 05
			FF 19 02 01 00
			15 01 00 00 00 00 02 00 80
			39 01 00 00 00 00 03
			FF 19 02
			15 01 00 00 00 00 02 00 83
			15 01 00 00 00 00 02 F3 CA
			15 01 00 00 00 00 02 00 90
			15 01 00 00 00 00 02 C4 00
			15 01 00 00 00 00 02 00 87
			15 01 00 00 00 00 02 A4 15
			15 01 00 00 00 00 02 00 BB
			39 01 00 00 00 00 03
			C5 33 30
			15 01 00 00 00 00 02 00 00
			15 01 00 00 00 00 02 35 00
			39 01 00 00 00 00 05
			2A 00 00 04 37
			39 01 00 00 00 00 05
			2B 00 00 07 7F
			05 01 00 00 78 00 01 11
			05 01 00 00 00 00 01 29];
		qcom,on-cmds-dsi-state = "DSI_LP_MODE";
		qcom,panel-off-cmds = [
			05 01 00 00 32 00 01 28
			05 01 00 00 64 00 01 10];
		qcom,off-cmds-dsi-state = "DSI_HS_MODE";
	};
};
